## buildroot/Config.in
```kconfig
source "$BR2_EXTERNAL_KAIROSOS_PATH/package/kairos-hermes/Config.in"

config BR2_PACKAGE_KAIROSOS
	bool "kairosos"
	select BR2_PACKAGE_PYTHON3
	select BR2_PACKAGE_PYTHON_PIP
	select BR2_PACKAGE_PYTHON_SETUPTOOLS
	select BR2_PACKAGE_NODEJS
	select BR2_PACKAGE_OPENSSH
	select BR2_PACKAGE_CA_CERTIFICATES
	help
	  KairosOS core meta-package

config BR2_PACKAGE_KAIROSOS_WEB
	bool "kairosos-web (web dashboard)"
	select BR2_PACKAGE_NODEJS
	default y
	help
	  KairosOS web dashboard for browser-based agent interaction

config BR2_PACKAGE_KAIROSOS_OPENCLAW
	bool "kairosos-openclaw (optional)"
	help
	  Include OpenClaw multi-channel gateway alongside Hermes
```

## buildroot/configs/kairosos_defconfig
```kconfig
# Architecture
BR2_x86_64=y
BR2_x86_64_x86_64=y

# Kernel
BR2_LINUX_KERNEL=y
BR2_LINUX_KERNEL_CUSTOM_VERSION=y
BR2_LINUX_KERNEL_CUSTOM_VERSION_VALUE="6.12"
BR2_LINUX_KERNEL_USE_DEFCONFIG=y
BR2_LINUX_KERNEL_DEFCONFIG="x86_64"
BR2_LINUX_KERNEL_CONFIG_FRAGMENT_FILES="$(BR2_EXTERNAL_KAIROSOS_PATH)/configs/kernel.config"
BR2_LINUX_KERNEL_NEEDS_HOST_OPENSSL=y

# System
BR2_TARGET_GENERIC_HOSTNAME="kairosos"
BR2_TARGET_GENERIC_ISSUE="Welcome to KairosOS — The AI Operating System"
BR2_TARGET_GENERIC_ROOT_PASSWD="kairos"
BR2_INIT_SYSTEMD=y
BR2_SYSTEM_DHCP="eth0"
BR2_TARGET_GENERIC_GETTY=y
BR2_TARGET_GENERIC_GETTY_PORT="tty1"

# RootFS
BR2_ROOTFS_OVERLAY="$(BR2_EXTERNAL_KAIROSOS_PATH)/board/kairosos/rootfs_overlay"
BR2_ROOTFS_POST_BUILD_SCRIPT="$(BR2_EXTERNAL_KAIROSOS_PATH)/board/kairosos/post-build.sh"
BR2_ROOTFS_POST_IMAGE_SCRIPT="$(BR2_EXTERNAL_KAIROSOS_PATH)/board/kairosos/post-image.sh"
BR2_ROOTFS_DEVICE_TABLE="$(BR2_EXTERNAL_KAIROSOS_PATH)/board/kairosos/device_table.txt"

# Filesystem images
BR2_TARGET_ROOTFS_EXT4=y
BR2_TARGET_ROOTFS_EXT4_SIZE="4G"
BR2_TARGET_ROOTFS_ISO9660=y
BR2_TARGET_ROOTFS_ISO9660_BOOT_MENU=y

# Required packages
BR2_PACKAGE_BUSYBOX=y
BR2_PACKAGE_CA_CERTIFICATES=y
BR2_PACKAGE_DHCPCD=y
BR2_PACKAGE_GIT=y
BR2_PACKAGE_OPENSSH=y
BR2_PACKAGE_OPENSSL=y
BR2_PACKAGE_CURL=y
BR2_PACKAGE_NANO=y
BR2_PACKAGE_SUDO=y
BR2_PACKAGE_TREE=y
BR2_PACKAGE_HTOP=y
BR2_PACKAGE_STRACE=y
BR2_PACKAGE_LSOF=y
BR2_PACKAGE_PROCPS_NG=y
BR2_PACKAGE_UTIL_LINUX=y
BR2_PACKAGE_E2FSPROGS=y
BR2_PACKAGE_NETCAT=y
BR2_PACKAGE_TCPDUMP=y
BR2_PACKAGE_IPTABLES=y
BR2_PACKAGE_NMAP=y
BR2_PACKAGE_SCREEN=y
BR2_PACKAGE_TMUX=y
BR2_PACKAGE_JQ=y
BR2_PACKAGE_RIPGREP=y
BR2_PACKAGE_FZF=y
BR2_PACKAGE_BAT=y

# Python (required for Hermes Agent)
BR2_PACKAGE_PYTHON3=y
BR2_PACKAGE_PYTHON3_PYOPT=y
BR2_PACKAGE_PYTHON_PIP=y
BR2_PACKAGE_PYTHON_SETUPTOOLS=y
BR2_PACKAGE_PYTHON_WHEEL=y
BR2_PACKAGE_PYTHON_REQUESTS=y
BR2_PACKAGE_PYTHON_PYYAML=y
BR2_PACKAGE_PYTHON_SQLITE=y
BR2_PACKAGE_PYTHON_JSONSCHEMA=y
BR2_PACKAGE_PYTHON_PACKAGING=y

# Node.js (for web dashboard)
BR2_PACKAGE_NODEJS=y
BR2_PACKAGE_NPM=y

# Custom packages
BR2_PACKAGE_KAIROS_HERMES=y
BR2_PACKAGE_KAIROSOS=y

# Toolchain
BR2_TOOLCHAIN_BUILDROOT_WCHAR=y
BR2_TOOLCHAIN_BUILDROOT_CXX=y
BR2_TOOLCHAIN_BUILDROOT_LOCALE=y

# Optimize for size
BR2_STRIP_strip=y
BR2_OPTIMIZE_2=y
```

## buildroot/package/kairos-hermes/Config.in
```kconfig
config BR2_PACKAGE_KAIROS_HERMES
	bool "kairos-hermes"
	select BR2_PACKAGE_PYTHON3
	select BR2_PACKAGE_PYTHON_PIP
	select BR2_PACKAGE_PYTHON_SETUPTOOLS
	select BR2_PACKAGE_PYTHON_WHEEL
	select BR2_PACKAGE_NODEJS
	select BR2_PACKAGE_GIT
	select BR2_PACKAGE_CURL
	help
	  Kairos Hermes Agent integration package.
	  Installs Hermes Agent as the primary AI assistant.
```

## meta-kairos/conf/layer.conf
```bitbake
BBPATH .= ":${LAYERDIR}"
BBFILES += "${LAYERDIR}/recipes-*/*/*.bb \
            ${LAYERDIR}/recipes-*/*/*.bbappend"

BBFILE_COLLECTIONS += "kairos"
BBFILE_PATTERN_kairos = "^${LAYERDIR}/"
BBFILE_PRIORITY_kairos = "10"

LAYERDEPENDS_kairos = "core openembedded-layer"
LAYERSERIES_COMPAT_kairos = "stylish"
```
